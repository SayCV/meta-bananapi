## conf/layer.conf
```bitbake
# We have a conf and classes directory, add to BBPATH
BBPATH .= ":${LAYERDIR}"

# We have recipes-* directories, add to BBFILES
BBFILES += "${LAYERDIR}/recipes-*/*/*.bb \
            ${LAYERDIR}/recipes-*/*/*.bbappend"

BBFILE_COLLECTIONS += "meta-bananapi"
BBFILE_PATTERN_meta-bananapi = "^${LAYERDIR}/"
BBFILE_PRIORITY_meta-bananapi = "6"

LAYERDEPENDS_meta-bananapi = "core"
LAYERSERIES_COMPAT_meta-bananapi = "sumo"
```

## conf/machine/bpi-w2-64.conf
```bitbake
#@TYPE: Machine
#@NAME: Banana Pi W2 Development Board
#@DESCRIPTION: Machine configuration for the Banana Pi W2 in 64 bits mode

MACHINEOVERRIDES = "BPI-w2-64:${MACHINE}"
require conf/machine/include/arm/arch-armv8.inc

SERIAL_CONSOLE ?= "115200 ttyS0"

IMAGE_CLASSES += "sdcard_image-bpi-w2"

PREFERRED_PROVIDER_virtual/kernel = "linux-rtk"

KERNEL_IMAGETYPE ?= "Image"
```
